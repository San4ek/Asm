;
; 2.asm
;
; Created: 14.04.2024 13:21:26
; Author : iNQU1SITOR
;
	.DEF x_reg=R16//задаем регистру R16 имя x_reg
	.DEF y_reg=R17//задаем регистру R17 имя y_reg

	.SET x_addr=x_val*2//передаем в переменную x_addr адрес, по которому хранится число X, умноженный на 2
	.SET y_addr=y_val*2//передаем в переменную y_addr адрес, по которому хранится число Y, умноженный на 2

	.DSEG//начало сегмента данных
y_var: .BYTE 2//резервируем в памяти 2 байта под искомое значение Y

//макрос передачи адреса @1 в двухбайтный регистр @0
	.MACRO LDA

	LDI @0H,HIGH(@1)//передаем в старший байт регистра @0 старший байт адреса
	LDI @0l,LOW(@1)//передаем в младший байт регистра @0 младший байт адреса

	.ENDM
//--------------------------------------------

//макрос передачи в регистр @0 значения, хранящегося по адресу @1, при помощи регистра Z
	.MACRO LDZ

	LDA Z,@1//загружаем адрес @1 в регистр Z
	LPM @0,Z//загружаем значение из памяти по адресу из регистра Z в регистр @0

	.ENDM
//-------------------------------------------

//макрос созранения значения из регистров @1 и @2 в память по адресу из @0 друг за другом
	.MACRO STA

	ST @0+,@1//сохранениее значения из регистра @1 в ячейку памяти с адресом из регистра @0 с последующим инкрементом
	ST @0+,@2//сохранениее значения из регистра @2 в ячейку памяти с адресом из регистра @0 с последующим инкрементом

	.ENDM
//------------------------------------------

	.LISTMAC//включаем генерацию листинга для макросов

//сама программа
	.CSEG//начало сегмента программы
start:
	LDA Y,y_var//загружаем в регистр Y адрес y_var

	RCALL ld_regs
	CP x_reg,y_reg//сравниваем x_reg и y_reg
	RCALL compare//вызов подпрограммы compare
	RCALL save//вызов подпрограммы save
	RET
//-------------------------------------------

//подпрограмма загрузки значений в регистры из соответствующих адресов
ld_regs:
	LDZ x_reg,x_addr//загружаем в x_reg значение по адресу x_addr
	LDZ y_reg,y_addr//загружаем в y_reg значение по адресу y_addr
	RET
//--------------------------------------------

//подпрограмма сохранения значений из R17 и val в ячейку памяти с адресом из Y
save:
	STA Y,y_reg,x_reg//сохраняем значения из y_reg и x_reg в ячейку памяти с адресом из Y
	RET//окончание подпрограммы
//------------------------------------------

//подпрограмма обработки результата сравнения
compare:
	BRSH more//переход на метку more, если результат сравнения >=
return:
	BRLO second//переход на метку second, если результат сравнения <
	BREQ second//переход на метку second, если результат сравнения =

more:
	BRNE first//переход на метку first, если результат сравнения !=
	JMP return//переход на метку return

first:
	ADD x_reg,y_reg//вычитаем из val константу 25
	CLR R17//очищаем регистр R17
	ADC R17,R17//суммируем регистр R17 с константой 0 с учетом переноса
	JMP end//переходим на метку end

second:
	MUL x_reg,y_reg//перемножаем val и val (возводим val в квадрат)
	MOV x_reg,R0//копируем значение из R0 в val
	MOV y_reg,R1//копируем значение из R1 в R17
	JMP end//переходим на метку end

end:
	RET//окончание подпрограммы
//-----------------------------------------------

x_val: .DB 255//резервируем один байт памяти под число x=255
y_val: .DB 254//резервируем один байт памяти под число y=255

